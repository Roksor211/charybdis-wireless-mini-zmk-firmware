/* Pointer / Trackball Tuning */
&{/} {
    pointer {
        compatible = "zmk,pointer";
        scale = <2>;
        acceleration-exponent = <1>;
        acceleration-factor = <15>;
        max-speed = <500>;
    };
};
