/* Firmware-only includes. Editable definitions live in qwerty.keymap. */
#ifndef KEYMAP_DRAWER
#include <behaviors.dtsi>
#include <dt-bindings/zmk/bt.h>
#include <dt-bindings/zmk/keys.h>
#include <dt-bindings/zmk/mouse.h>
#include <dt-bindings/zmk/outputs.h>
#include <behaviors/mouse_keys.dtsi>
#include <dt-bindings/zmk/ext_power.h>
#include "pointer.dtsi"
#endif
